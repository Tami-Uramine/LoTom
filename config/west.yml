## config/west.yml
```yaml
manifest:
  remotes:
    - name: zmkfirmware
      url-base: https://github.com/zmkfirmware
    - name: badjeff
      url-base: https://github.com/badjeff
    - name: pukuhei
      url-base: https://github.com/pukuhei
    - name: kot149
      url-base: https://github.com/kot149
  projects:
    - name: zmk
      remote: zmkfirmware
      revision: v0.3
      import: app/west.yml
    - name: zmk-pmw3610-driver
      remote: badjeff
      revision: zmk-0.3
    - name: zmk-tom-oled
      url: https://github.com/Tami-Uramine/zmk-tom-oled
      revision: main
    - name: zmk-scroll-snap
      remote: kot149
      revision: v1
  self:
    path: config
```
